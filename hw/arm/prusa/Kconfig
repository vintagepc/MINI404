## hw/arm/prusa/Kconfig
```kconfig
config BUDDYBOARD
    bool
    select STM32F407_SOC
    select SMBUS_EEPROM
    select SSI_M25P80
    select AT24C

config STM32F407_SOC
    bool
    select ARM_V7M
    select OR_IRQ
    select SPLIT_IRQ
    select STM32F2XX_TIMER
    select STM32F2XX_SYSCFG
    select SSI
    select STM32F4XX_SYSCFG
    select STM32F4XX_EXTI
    select USB
```
